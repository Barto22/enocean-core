## platform/zephyr_core/Kconfig
```kconfig
source "Kconfig.zephyr"

rsource "usb_common/Kconfig.common_usbd"

menu "Zephyr Core Configuration"

module = MAIN
module-str = main
source "subsys/logging/Kconfig.template.log_config"

endmenu
```

## platform/zephyr_core/Kconfig.sysbuild
```kconfig
source "${ZEPHYR_BASE}/share/sysbuild/Kconfig"

config NET_CORE_BOARD
	string
	default "nrf7002dk/nrf5340/cpunet" if "$(BOARD)" = "nrf7002dk"
	default "nrf5340dk/nrf5340/cpunet" if "$(BOARD)" = "nrf5340dk"

config NET_CORE_IMAGE_HCI_IPC
	bool "Build hci_ipc image for network core"
	default y
	depends on NET_CORE_BOARD != ""
```

## platform/zephyr_core/boards/nrf7002dk_nrf5340_cpuapp.conf
```kconfig
CONFIG_MBEDTLS_PSA_CRYPTO_EXTERNAL_RNG=n
CONFIG_MBEDTLS_PSA_CRYPTO_EXTERNAL_RNG_ALLOW_NON_CSPRNG=n
```

## platform/zephyr_core/sysbuild/mcuboot/boards/nrf7002dk_nrf5340_cpuapp.conf
```kconfig
CONFIG_UART_CONSOLE=n
CONFIG_MAIN_STACK_SIZE=10240
CONFIG_MBEDTLS_PSA_CRYPTO_EXTERNAL_RNG=n
CONFIG_MBEDTLS_PSA_CRYPTO_EXTERNAL_RNG_ALLOW_NON_CSPRNG=n
```

## platform/zephyr_core/usb_common/Kconfig.common_usbd
```kconfig
# Copyright (c) 2023 Nordic Semiconductor ASA
# SPDX-License-Identifier: Apache-2.0

# This file contains Kconfig options and defaults for configuring USB devices
# using the new experimental USB device support. The scope of these options is
# limited to USB samples in project tree, you cannot use them in your own
# application.

menu "USB sample options"
	depends on USB_DEVICE_STACK_NEXT

config COMMON_USBD_MANUFACTURER
	string "USB device sample manufacturer string"
	default "Asbar Technology"
	help
	  USB device sample manufacturer string.

config COMMON_USBD_PRODUCT
	string "USB device sample product string"
	default "USBD CDC ACM"
	help
	  USB device sample product stringa.

config COMMON_USBD_VID
	hex "USB device sample Vendor ID"
	default 0x2fe3
	help
	  USB device sample Vendor ID. The default id (0x2fe3) is associated to
	  Zephyr Project, you must use your own VID for samples and applications
	  outside of Zephyr Project.

config COMMON_USBD_PID
	hex "USB device sample Product ID"
	default 0x0001
	help
	  USB device sample Product ID. You must use your own PID for samples
	  and applications outside of Zephyr Project.

config COMMON_USBD_SELF_POWERED
	bool "USB device sample Self-powered attribute"
	default y
	help
	  Set the Self-powered attribute in the sample configuration.

config COMMON_USBD_REMOTE_WAKEUP
	bool "USB device sample Remote Wakeup attribute"
	help
	  Set the Remote Wakeup attribute in the sample configuration.

config COMMON_USBD_MAX_POWER
	int "USB device sample bMaxPower value"
	default 125
	range 0 250
	help
	  bMaxPower value in the sample configuration in 2 mA units.

config COMMON_USBD_20_EXTENSION_DESC
	bool "Use default USB 2.0 Extension Descriptor"
	depends on USBD_BOS_SUPPORT
	help
	  Set bcdUSB value to 0201 and use default USB 2.0 Extension Descriptor.

endmenu
```
